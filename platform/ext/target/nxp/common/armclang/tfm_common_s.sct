/*
 * Copyright (c) 2017-2023 Arm Limited. All rights reserved.
 * Copyright (c) 2022 Cypress Semiconductor Corporation (an Infineon company)
 * or an affiliate of Cypress Semiconductor Corporation. All rights reserved.
 *
 * Licensed under the Apache License, Version 2.0 (the "License");
 * you may not use this file except in compliance with the License.
 * You may obtain a copy of the License at
 *
 *     http://www.apache.org/licenses/LICENSE-2.0
 *
 * Unless required by applicable law or agreed to in writing, software
 * distributed under the License is distributed on an "AS IS" BASIS,
 * WITHOUT WARRANTIES OR CONDITIONS OF ANY KIND, either express or implied.
 * See the License for the specific language governing permissions and
 * limitations under the License.
 */

#include "region_defs.h"

/* Include file with definitions for section alignments.
 * Note: it should be included after region_defs.h to let platform define
 * default values if needed. */
#include "tfm_s_linker_alignments.h"

// --------- NXP --------------
#ifdef M_BOOT_FLASH_CONF_START
/* Flash configuration block(FCB) is used to configure the FlexSPI interface during the boot process. */
LR_FLASH_CONFIG M_BOOT_FLASH_CONF_START {
  FLASH_CONFIG M_BOOT_FLASH_CONF_START M_BOOT_FLASH_CONF_SIZE {
    * (.flash_conf)
  }
}
#endif
// --------- NXP end --------------
  
LR_CODE S_CODE_START S_CODE_SIZE {
    PT_RO_START +0 ALIGN TFM_LINKER_PT_RO_ALIGNMENT EMPTY 0x0 {
        /* Position tag: code + RO-data */
    }

    /****  This initial section contains common code for secure binary */
    ER_VECTORS S_CODE_START S_CODE_VECTOR_TABLE_SIZE {
        *.o (RESET +First)
    }
#ifdef CONFIG_TFM_USE_TRUSTZONE
    ER_VECTORS_FILL +0 EMPTY (S_CODE_VECTOR_TABLE_SIZE - ImageLength(ER_VECTORS)) {
    }
// NXP
#if !defined(VENEER_PLACE_IN_SRAM) || (VENEER_PLACE_IN_SRAM == 0)
    /*
     * Place the CMSE Veneers (containing the SG instruction) in a separate
     * 32 bytes aligned region so that the SAU can be programmed to
     * just set this region as Non-Secure Callable.
     */
    ER_VENEER +0 FIXED ALIGN TFM_LINKER_VENEERS_ALIGNMENT {
        *(Veneer$$CMSE)
    }
    /*
     * The Limit of the VENEER_ALIGN region should be at least 32 bytes aligned
     * so that the SAU can set this region as Non-Secure Callable.
     */
    VENEER_ALIGN +0 ALIGN TFM_LINKER_VENEERS_ALIGNMENT EMPTY 0x0 {
    }
#endif
#endif
//NXP
#if defined(CONFIG_TFM_USE_TRUSTZONE) && defined(VENEER_PLACE_IN_SRAM) && (VENEER_PLACE_IN_SRAM == 1)
    /*
     * ER_VENEER is placed in the NSC execution region at NSC_VENEER_START.
     * ER_VECTORS_FILL is EMPTY and does not consume load space, so force
     * ER_TFM_CODE to be a root region at its execution address.
     */
    ER_TFM_CODE +0 FIXED {
#else
    ER_TFM_CODE +0 {
#endif
        *startup*(.text*)
        *libplatform_s* (.text*, .rodata*)
        *libtfm_spm* (+RO)
    }

    /**** Unprivileged Secure code start here */
    TFM_UNPRIV_CODE_START +0 ALIGN TFM_LINKER_UNPRIV_CODE_ALIGNMENT {
        * (+RO)
    }

    /*
     * This empty, zero long execution region is here to mark the end address
     * of TFM unprivileged code.
     */
    TFM_UNPRIV_CODE_END +0 ALIGN TFM_LINKER_UNPRIV_CODE_ALIGNMENT EMPTY 0x0 {
    }

    /**** Section for holding partition RO load data */
    /*
     * Sort the partition info by priority to guarantee the initing order.
     * The first loaded partition will be inited at last in SFN model.
     */
    TFM_SP_LOAD_LIST +0 ALIGN 4 {
        *(.part_load_priority_00)
        *(.part_load_priority_01)
        *(.part_load_priority_02)
        *(.part_load_priority_03)
    }

    /**** PSA RoT RO part (CODE + RODATA) start here */
    /*
     * This empty, zero long execution region is here to mark the start address
     * of PSA RoT code.
     */
    TFM_PSA_CODE_START +0 ALIGN TFM_LINKER_PSA_ROT_LINKER_CODE_ALIGNMENT EMPTY 0x0 {
    }

    TFM_PSA_ROT_LINKER +0 ALIGN TFM_LINKER_PSA_ROT_LINKER_CODE_ALIGNMENT {
        *tfm_psa_rot_partition* (+RO-CODE, +RO-DATA)
        *libplatform_s* (TFM_*_PSA-ROT_ATTR_FN)
        *.o (TFM_*_PSA-ROT_ATTR_FN)
    }

    /*
     * This empty, zero long execution region is here to mark the end address
     * of PSA RoT code.
     */
    TFM_PSA_CODE_END +0 ALIGN TFM_LINKER_PSA_ROT_LINKER_CODE_ALIGNMENT EMPTY 0x0 {
    }

    /**** APPLICATION RoT RO part (CODE + RODATA) start here */
    /*
     * This empty, zero long execution region is here to mark the start address
     * of APP RoT code.
     */
    TFM_APP_CODE_START +0 ALIGN TFM_LINKER_APP_ROT_LINKER_CODE_ALIGNMENT EMPTY 0x0 {
    }

    TFM_APP_ROT_LINKER +0 ALIGN TFM_LINKER_APP_ROT_LINKER_CODE_ALIGNMENT {
        *tfm_app_rot_partition* (+RO-CODE, +RO-DATA)
        *libplatform_s* (TFM_*_APP-ROT_ATTR_FN)
        *.o (TFM_*_APP-ROT_ATTR_FN)
// --------- NXP --------------
// #ifdef TFM_PARTITION_PROTECTED_STORAGE
        *tfm_ps_req_mngr.*  (+RO)
        *tfm_protected_storage.*  (+RO)
        *ps_object_system.*  (+RO)
        *ps_object_table.*  (+RO)
        *ps_utils.*  (+RO)
        *ps_crypto_interface.*  (+RO)
        *ps_encrypted_object.*  (+RO)
        *ps_nv_counters.*  (+RO)
        *intermedia_tfm_protected_storage.*  (+RO)
        *load_info_tfm_protected_storage.*  (+RO)
        *(TFM_SP_PS_ATTR_FN)

// #ifdef TFM_PARTITION_IPC_TEST
        *tfm_ipc_client_test.*  (+RO)
        *intermedia_tfm_ipc_client_test.*  (+RO)
        *load_info_tfm_ipc_client_test.*  (+RO)
        *(TFM_SP_IPC_CLIENT_TEST_ATTR_FN)

// #ifdef TFM_S_REG_TEST
        *tfm_secure_client_2.*  (+RO)
        *intermedia_tfm_secure_client_2.*  (+RO)
        *load_info_tfm_secure_client_2.*  (+RO)
        *tfm_secure_client_2_api.*  (+RO)
        *tfm_secure_client_2_api.*  (+RO)
        *(TFM_SP_SECURE_CLIENT_2_ATTR_FN)

// #ifdef TEST_PARTITION_FPU_TEST
        *tfm_fpu_service_test.*  (+RO)
        *intermedia_tfm_fpu_service_test.*  (+RO)
        *load_info_tfm_fpu_service_test.*  (+RO)
        *(TFM_SP_FPU_SERVICE_TEST_ATTR_FN)

// --------- NXP end --------------
    }

    /*
     * This empty, zero long execution region is here to mark the end address
     * of APP RoT code.
     */
    TFM_APP_CODE_END +0 ALIGN TFM_LINKER_APP_ROT_LINKER_CODE_ALIGNMENT EMPTY 0x0 {
    }

#if defined(S_RAM_CODE_START)

#if defined(VENEER_PLACE_IN_SRAM) && (VENEER_PLACE_IN_SRAM == 1)

    /*
     * RT700 workaround:
     * Keep ER_CODE_SRAM limited to RAM_VENEER_OFFSET for consistency with
     * IAR/armgcc layouts. CMSE/NSC veneers themselves are placed at
     * NSC_VENEER_START, i.e. 0x1000FC00.
     */
    ER_CODE_SRAM S_RAM_CODE_START ALIGN 4 RAM_VENEER_OFFSET {
        *libflash_drivers* (+RO)
        * (.ramfunc)
    }

#else

    /*
     * Default behavior:
     * Entire S_RAM_CODE_SIZE is available for RAM-executed code.
     */
    ER_CODE_SRAM S_RAM_CODE_START ALIGN 4 S_RAM_CODE_SIZE {
        *libflash_drivers* (+RO)
        * (.ramfunc)
    }

#endif
    /* This empty, zero long execution region is here to mark the limit
     * address of the last execution region that is allocated in CODE_SRAM.
     */
    ER_CODE_SRAM_WATERMARK +0 EMPTY 0x0 {
    }

#if defined(VENEER_PLACE_IN_SRAM) && (VENEER_PLACE_IN_SRAM == 1)
    ScatterAssert(ImageLimit(ER_CODE_SRAM_WATERMARK) <=
                  S_RAM_CODE_START + RAM_VENEER_OFFSET)

    /*
     * Match IAR/armgcc model:
     * CMSE/NSC veneers execute from 0x1000FC00.
     */
    ER_VENEER NSC_VENEER_START ALIGN TFM_LINKER_VENEERS_ALIGNMENT NSC_VENEER_SLOT_SIZE {
        *(Veneer$$CMSE)
    }

    VENEER_ALIGN +0 ALIGN TFM_LINKER_VENEERS_ALIGNMENT EMPTY 0x0 {
    }

    ER_VENEER_WATERMARK +0 EMPTY 0x0 {
    }

    ScatterAssert(ImageBase(ER_VENEER) == NSC_VENEER_START)
    ScatterAssert(ImageLimit(ER_VENEER_WATERMARK) <=
                  NSC_VENEER_START + NSC_VENEER_SLOT_SIZE)

#else

    ScatterAssert(ImageLimit(ER_CODE_SRAM_WATERMARK) <=
                  S_RAM_CODE_START + S_RAM_CODE_SIZE)
#endif
#endif /* S_RAM_CODE_START */

    PT_RO_END +0 ALIGN TFM_LINKER_PT_RO_ALIGNMENT EMPTY 0x0 {
        /* Position tag */
    }

    /**** Base address of secure data area */
    TFM_SECURE_DATA_START S_DATA_START EMPTY 0x0{                 //NXP
    }

    /*
     * MPU on Armv6-M/v7-M core in multi-core topology may require more strict
     * alignment that MPU region base address must align with the MPU region
     * size.
     * As a result, on Armv6-M/v7-M cores, to save memory resource and MPU
     * regions, unprivileged data sections and privileged data sections are
     * separated and gathered in unprivileged/privileged data area respectively.
     * Keep BL2 shared data and MSP stack at the beginning of the secure data
     * area on Armv8-M cores, while move the two areas to the beginning of
     * privileged data region on Armv6-M/v7-M cores.
     */
#if defined(__ARM_ARCH_8M_MAIN__) || defined(__ARM_ARCH_8M_BASE__) || \
    defined(__ARM_ARCH_8_1M_MAIN__)
#ifdef CODE_SHARING
    /* The code sharing between bootloader and runtime requires to share the
     * global variables.
     */
    TFM_SHARED_SYMBOLS +0 ALIGN TFM_LINKER_SHARED_SYMBOLS_ALIGNMENT EMPTY SHARED_SYMBOL_AREA_SIZE {
    }
#endif

    /* Shared area between BL2 and runtime to exchange data */
    TFM_SHARED_DATA +0 ALIGN TFM_LINKER_BL2_SHARED_DATA_ALIGNMENT OVERLAY EMPTY BOOT_TFM_SHARED_DATA_SIZE {
    }

    /* MSP */
    ARM_LIB_STACK +0 ALIGN TFM_LINKER_MSP_STACK_ALIGNMENT OVERLAY EMPTY S_MSP_STACK_SIZE - 0x8 {
    }

    STACKSEAL +0 EMPTY 0x8 {
    }

#endif /* defined(__ARM_ARCH_8M_MAIN__) || defined(__ARM_ARCH_8M_BASE__) || \
        * defined(__ARM_ARCH_8_1M_MAIN__) */

#if defined(CONFIG_TFM_PARTITION_META)
    TFM_SP_META_PTR +0 ALIGN TFM_LINKER_SP_META_PTR_ALIGNMENT {
        *(.bss.SP_META_PTR_SPRTL_INST)
    }
    /*
     * This empty, zero long execution region is here to mark the end address
     * of TFM partition metadata pointer region.
     */
    TFM_SP_META_PTR_END +0 ALIGN TFM_LINKER_SP_META_PTR_ALIGNMENT EMPTY 0x0 {
    }
#endif

    /**** APP RoT DATA start here */
    /*
     * This empty, zero long execution region is here to mark the start address
     * of APP RoT RW and Stack.
     */
    TFM_APP_RW_STACK_START +0 ALIGN TFM_LINKER_APP_ROT_LINKER_DATA_ALIGNMENT EMPTY 0x0 {
    }

    TFM_APP_ROT_LINKER_DATA +0 ALIGN TFM_LINKER_APP_ROT_LINKER_DATA_ALIGNMENT {
        *tfm_app_rot_partition* (+RW +ZI)
        *.o(TFM_*_APP-ROT_ATTR_RW)
        *.o(TFM_*_APP-ROT_ATTR_ZI)
// --------- NXP --------------
// #ifdef TFM_PARTITION_PROTECTED_STORAGE
        *tfm_ps_req_mngr.*  (+RW +ZI)
        *tfm_protected_storage.*  (+RW +ZI)
        *ps_object_system.*  (+RW +ZI)
        *ps_object_table.*  (+RW +ZI)
        *ps_utils.*  (+RW +ZI)
        *ps_crypto_interface.*  (+RW +ZI)
        *ps_encrypted_object.*  (+RW +ZI)
        *ps_nv_counters.*  (+RW +ZI)
        *intermedia_tfm_protected_storage.*  (+RW +ZI)
        *load_info_tfm_protected_storage.*  (+RW +ZI)
        *(TFM_SP_PS_ATTR_RW)
        *(TFM_SP_PS_ATTR_ZI)

// #ifdef TFM_PARTITION_IPC_TEST
        *tfm_ipc_client_test.*  (+RW +ZI)
        *intermedia_tfm_ipc_client_test.*  (+RW +ZI)
        *load_info_tfm_ipc_client_test.*  (+RW +ZI)
        *(TFM_SP_IPC_CLIENT_TEST_ATTR_RW)
        *(TFM_SP_IPC_CLIENT_TEST_ATTR_ZI)

// #ifdef TFM_S_REG_TEST
        *tfm_secure_client_2.*  (+RW +ZI)
        *intermedia_tfm_secure_client_2.*  (+RW +ZI)
        *load_info_tfm_secure_client_2.*  (+RW +ZI)
        *tfm_secure_client_2_api.*  (+RW +ZI)
        *tfm_secure_client_2_api.*  (+RW +ZI)
        *(TFM_SP_SECURE_CLIENT_2_ATTR_RW)
        *(TFM_SP_SECURE_CLIENT_2_ATTR_ZI)

// #ifdef TEST_PARTITION_FPU_TEST
        *tfm_fpu_service_test.*  (+RW +ZI)
        *intermedia_tfm_fpu_service_test.*  (+RW +ZI)
        *load_info_tfm_fpu_service_test.*  (+RW +ZI)
        *(TFM_SP_FPU_SERVICE_TEST_ATTR_RW)
        *(TFM_SP_FPU_SERVICE_TEST_ATTR_ZI)

// --------- NXP end --------------
    }

    /*
     * This empty, zero long execution region is here to mark the end address
     * of APP RoT RW and Stack.
     */
    TFM_APP_RW_STACK_END +0 ALIGN TFM_LINKER_APP_ROT_LINKER_DATA_ALIGNMENT EMPTY 0x0 {
    }

#if defined(__ARM_ARCH_6M__) || defined(__ARM_ARCH_7M__) || \
    defined(__ARM_ARCH_7EM__)
#ifdef S_DATA_PRIV_START
    /**** Privileged data area base address specified by Armv6-M/v7-M platform */
    TFM_SECURE_PRIV_DATA_BOUNDARY S_DATA_PRIV_START {
    }
#endif

    /*
     * Move BL2 shared area and MSP stack to the beginning of privileged data
     * area on Armv6-M/v7-M platforms.
     */
    /* Shared area between BL2 and runtime to exchange data */
    TFM_SHARED_DATA +0 ALIGN TFM_LINKER_BL2_SHARED_DATA_ALIGNMENT OVERLAY EMPTY BOOT_TFM_SHARED_DATA_SIZE {
    }

    /* MSP */
    ARM_LIB_STACK +0 ALIGN TFM_LINKER_MSP_STACK_ALIGNMENT OVERLAY EMPTY S_MSP_STACK_SIZE {
    }
#endif /* defined(__ARM_ARCH_6M__) || defined(__ARM_ARCH_7M__) || \
        * defined(__ARM_ARCH_7EM__) */

#if defined(ENABLE_HEAP)            //NXP enable heap usage
    ARM_LIB_HEAP +0 ALIGN 8 EMPTY S_HEAP_SIZE {
    }
#endif

    ER_TFM_DATA +0 {
        * (CodeQuickAccess)         //NXP
        * (DataQuickAccess)         //NXP
        * (+RW +ZI)
    }

    /**** The runtime partition placed order is same as load partition */
    ER_PART_RT_POOL +0 ALIGN 4 {
        *(.bss.part_runtime_priority_00)
        *(.bss.part_runtime_priority_01)
        *(.bss.part_runtime_priority_02)
        *(.bss.part_runtime_priority_03)
    }

    /**** The runtime service placed order is same as load partition */
    ER_SERV_RT_POOL +0 ALIGN 4 {
        *(.bss.serv_runtime_priority_00)
        *(.bss.serv_runtime_priority_01)
        *(.bss.serv_runtime_priority_02)
        *(.bss.serv_runtime_priority_03)
    }

    /**** PSA RoT DATA start here */
    /*
     * This empty, zero long execution region is here to mark the start address
     * of PSA RoT RW and Stack.
     */
    TFM_PSA_RW_STACK_START +0 ALIGN TFM_LINKER_PSA_ROT_LINKER_DATA_ALIGNMENT EMPTY 0x0 {
    }

    TFM_PSA_ROT_LINKER_DATA +0 ALIGN TFM_LINKER_PSA_ROT_LINKER_DATA_ALIGNMENT {
        *tfm_psa_rot_partition* (+RW +ZI)
        *.o(TFM_*_PSA-ROT_ATTR_RW)
        *.o(TFM_*_PSA-ROT_ATTR_ZI)
    }

    /*
     * This empty, zero long execution region is here to mark the end address
     * of PSA RoT RW and Stack.
     */
    TFM_PSA_RW_STACK_END +0 ALIGN TFM_LINKER_PSA_ROT_LINKER_DATA_ALIGNMENT EMPTY 0x0 {
    }

#ifdef RAM_VECTORS_SUPPORT
    ER_RAM_VECTORS +0 ALIGN TFM_LINKER_RAM_VECTORS_ALIGNMENT UNINIT {
        * (RESET_RAM)
    }
#endif

    /* This empty, zero long execution region is here to mark the limit address
     * of the last execution region that is allocated in SRAM.
     */
    SRAM_WATERMARK +0 EMPTY 0x0 {
    }

    /* Make sure that the sections allocated in the SRAM does not exceed the
     * size of the SRAM available.
     */
    ScatterAssert(ImageLimit(SRAM_WATERMARK) <= S_DATA_START + S_DATA_SIZE)
}

LR_NS_PARTITION NS_PARTITION_START {
    /* Reserved place for NS application.
     * No code will be placed here, just address of this region is used in the
     * secure code to configure certain HW components.
     */
    ER_NS_PARTITION NS_PARTITION_START EMPTY NS_PARTITION_SIZE {        //NXP to avoid warning
    }
}

#ifdef BL2
LR_SECONDARY_PARTITION SECONDARY_PARTITION_START {
    /* Reserved place for new image in case of firmware upgrade.
     * No code will be placed here, just address of this region is used in the
     * secure code to configure certain HW components. This generates an empty
     * execution region description warning during linking.
     */
    ER_SECONDARY_PARTITION SECONDARY_PARTITION_START \
        UNINIT SECONDARY_PARTITION_SIZE {
    }
}
#endif /* BL2 */
// --------- NXP --------------
#ifdef TFM_WIFI_FLASH_REGION
LR_WIFI_FLASH_REGION WIFI_FLASH_REGION_START {
    /* Reserved region for connectivity firmware, made accessible to NS
     * application.
     */
    ER_WIFI_FLASH_REGION WIFI_FLASH_REGION_START EMPTY WIFI_FLASH_REGION_SIZE {
    }
}
#endif /* TFM_WIFI_FLASH_REGION */

#ifdef TFM_EL2GO_DATA_IMPORT_REGION
LR_EL2GO_DATA_IMPORT_REGION EL2GO_DATA_IMPORT_REGION_START {
    /* Reserved region for EL2GO offline-provisioned blobs, made accessible to 
     * NS application.
     */
    ER_EL2GO_DATA_IMPORT_REGION EL2GO_DATA_IMPORT_REGION_START EMPTY EL2GO_DATA_IMPORT_REGION_SIZE {
    }
}
#endif /* TFM_EL2GO_DATA_IMPORT_REGION */

#ifdef TFM_EL2GO_CMPA_REGION
LR_EL2GO_CMPA_REGION EL2GO_CMPA_REGION_START {
    /* CMPA region for EL2GO apps, made accessible to NS application. */
    ER_EL2GO_CMPA_REGION EL2GO_CMPA_REGION_START EMPTY EL2GO_CMPA_REGION_SIZE {
    }
}
#endif /* TFM_EL2GO_CMPA_REGION */

/* ncache is a non-cacheable memory region intended for data that must bypass cache operations, such as DMA buffers or shared memory with peripherals. */
#ifdef TFM_NCACHE_REGION_ENABLE

#define m_ncache_start               0x30200000
#define m_ncache_size                0x00200000

LR_NCACHE m_ncache_start{
    RW_m_ncache m_ncache_start m_ncache_size{
        *(NonCacheable.init)
        *(NonCacheable)
    }
    RW_m_ncache_unused (m_ncache_start + m_ncache_size) 
    {
        ; Empty region added for MPU configuration
    }
}
#endif /*TFM_NCACHE_REGION_ENABLE*/

// --------- NXP end --------------
