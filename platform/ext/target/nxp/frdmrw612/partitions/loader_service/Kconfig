## platform/ext/target/nxp/frdmrw612/partitions/loader_service/Kconfig
```kconfig
#-------------------------------------------------------------------------------
# Copyright (c) 2023, Arm Limited. All rights reserved.
# Copyright 2024 NXP
#
# SPDX-License-Identifier: BSD-3-Clause
#
#-------------------------------------------------------------------------------

menuconfig TFM_PARTITION_LOADER_SERVICE
    bool "Loader Service secure partition"
    default y
```

## platform/ext/target/nxp/frdmrw612/partitions/loader_service/Kconfig.comp
```kconfig
#-------------------------------------------------------------------------------
# Copyright (c) 2023, Arm Limited. All rights reserved.
# Copyright 2024 NXP
#
# SPDX-License-Identifier: BSD-3-Clause
#
#-------------------------------------------------------------------------------

menu "Loader Service partition component configs"
    depends on TFM_PARTITION_LOADER_SERVICE

config LDS_STACK_SIZE
    hex "Stack size"
    default 0xC00

endmenu
```
