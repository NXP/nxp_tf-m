## mcux/Kconfig
```kconfig
#
# Copyright 2024-2026 NXP
#
# SPDX-License-Identifier: BSD-3-Clause

menu "TF-M (Trusted Firmware-M)"

    config MCUX_COMPONENT_middleware.tfm.board_headers
        bool

    config MCUX_COMPONENT_middleware.tfm.driver_headers
        bool

    config MCUX_COMPONENT_middleware.tfm.common_headers
        bool

    menu "Secure Processing Environment"    
        config MCUX_COMPONENT_middleware.tfm.s
            bool "TF-M Secure"
            select MCUX_COMPONENT_middleware.tfm.s.crypto
            select MCUX_COMPONENT_middleware.tfm.s.its
            select MCUX_COMPONENT_middleware.tfm.s.board
            select MCUX_COMPONENT_middleware.tfm.s.protected_storage if (MCUX_COMPONENT_middleware.tfm.profile_large || MCUX_COMPONENT_middleware.tfm.profile_medium)
            select MCUX_COMPONENT_middleware.tfm.driver_headers
            select MCUX_COMPONENT_middleware.tfm.common_headers
            select MCUX_COMPONENT_middleware.tfm.s.platform
            select MCUX_COMPONENT_middleware.tfm.s.platform_common if (!(MCUX_HW_DEVICE_RW610 || MCUX_HW_DEVICE_RW612))
            select MCUX_COMPONENT_middleware.tfm.s.platform_rw61x if (MCUX_HW_DEVICE_RW610 || MCUX_HW_DEVICE_RW612)
            select MCUX_COMPONENT_middleware.tfm.s.partition_load_ps if (MCUX_COMPONENT_middleware.tfm.s.protected_storage)
            select MCUX_COMPONENT_middleware.tfm.s.test.partition_load_ps_tests if (MCUX_COMPONENT_middleware.tfm.s.test.protected_storage)
        config MCUX_COMPONENT_middleware.tfm.s.board
            bool
            select MCUX_COMPONENT_middleware.tfm.board_headers

        config MCUX_COMPONENT_middleware.tfm.s.platform_common
            bool "Platform Common"
            depends on !(MCUX_HW_DEVICE_RW610 || MCUX_HW_DEVICE_RW612)

        config MCUX_COMPONENT_middleware.tfm.s.platform_rw61x
            bool "RW61x Platform"
            select MCUX_COMPONENT_middleware.tfm.s.loader_service
            depends on MCUX_HW_DEVICE_RW610 || MCUX_HW_DEVICE_RW612

        config MCUX_COMPONENT_middleware.tfm.s.platform_nv_seed
            bool "Use Default NV seed in RAM"

        config MCUX_COMPONENT_middleware.tfm.s.accelerator
            default y if (MCUX_COMPONENT_middleware.tfm.s && !MCUX_COMPONENT_middleware.tfm.s.platform_nv_seed)
            bool "Use Crypto HW Accelerator"

        menu "Partitions"
            config MCUX_COMPONENT_middleware.tfm.s.platform
                bool "Platform"
                select MCUX_COMPONENT_middleware.tfm.s.platform.sp_common if (!(MCUX_HW_DEVICE_RW610 || MCUX_HW_DEVICE_RW612))
                select MCUX_COMPONENT_middleware.tfm.s.platform.sp_rw61x if (MCUX_HW_DEVICE_RW610 || MCUX_HW_DEVICE_RW612)

            config MCUX_COMPONENT_middleware.tfm.s.platform.sp_common
                bool
                depends on !(MCUX_HW_DEVICE_RW610 || MCUX_HW_DEVICE_RW612)

            config MCUX_COMPONENT_middleware.tfm.s.platform.sp_rw61x
                bool
                depends on MCUX_HW_DEVICE_RW610 || MCUX_HW_DEVICE_RW612

            config MCUX_COMPONENT_middleware.tfm.s.crypto
                bool "Crypto"
                select MCUX_COMPONENT_component.psa_crypto_driver.els_pkc if ((MCUX_HW_DEVICE_RW610 || MCUX_HW_DEVICE_RW612 || MCUX_HW_DEVICE_MCXN235 || MCUX_HW_DEVICE_MCXN236 || MCUX_HW_DEVICE_MCXN546 || MCUX_HW_DEVICE_MCXN547 || MCUX_HW_DEVICE_MCXN946 || MCUX_HW_DEVICE_MCXN947 || MCUX_HW_DEVICE_MIMXRT735S || MCUX_HW_DEVICE_MIMXRT758S || MCUX_HW_DEVICE_MIMXRT798S))
                select MCUX_COMPONENT_component.psa_crypto_driver.ele_s200 if ((MCUX_HW_DEVICE_KW45Z41052 || MCUX_HW_DEVICE_KW45Z41053 || MCUX_HW_DEVICE_KW45Z41082 || MCUX_HW_DEVICE_KW45Z41083 || MCUX_HW_DEVICE_KW45B41Z82 || MCUX_HW_DEVICE_KW45B41Z52 || MCUX_HW_DEVICE_KW45B41Z53 || MCUX_HW_DEVICE_KW45B41Z83 || MCUX_HW_DEVICE_MCXW716C || MCUX_HW_DEVICE_MCXW716A || MCUX_HW_DEVICE_MCXW727A || MCUX_HW_DEVICE_MCXW727C || MCUX_HW_DEVICE_MCXW727D || MCUX_HW_DEVICE_KW47B42Z83 || MCUX_HW_DEVICE_KW47B42Z96 || MCUX_HW_DEVICE_KW47B42Z97 || MCUX_HW_DEVICE_KW47B42ZB2 || MCUX_HW_DEVICE_KW47B42ZB3 || MCUX_HW_DEVICE_KW47B42ZB6 || MCUX_HW_DEVICE_KW47B42ZB7 || MCUX_HW_DEVICE_KW47Z42082 || MCUX_HW_DEVICE_KW47Z42092 || MCUX_HW_DEVICE_KW47Z420B2 || MCUX_HW_DEVICE_KW47Z420B3))
                select MCUX_COMPONENT_middleware.mbedtls3x.crypto if (MCUX_HW_DEVICE_MCXW236 || MCUX_HW_DEVICE_MCXW235 || MCUX_HW_DEVICE_MCXL255)
                select MCUX_COMPONENT_middleware.mbedtls3x.p256m if (MCUX_COMPONENT_middleware.tfm.profile_medium && MCUX_COMPONENT_middleware.tfm.s)

            menu "Initial Attestation"
                config MCUX_COMPONENT_middleware.tfm.s.initial_attestation
                    bool "Initial Attestation"
                    select MCUX_COMPONENT_middleware.tfm.qcbor
                config MCUX_COMPONENT_middleware.tfm.s.initial_attestation.asymmetric
                    bool "Initial Attestation Asymmetric"
                    default y if (MCUX_COMPONENT_middleware.tfm.s.initial_attestation && (MCUX_COMPONENT_middleware.tfm.profile_large.client_configs || MCUX_COMPONENT_middleware.tfm.profile_medium.client_configs))

                config MCUX_COMPONENT_middleware.tfm.s.initial_attestation.symmetric
                    bool "Initial Attestation Symmetric"
                    default y if (MCUX_COMPONENT_middleware.tfm.s.initial_attestation && MCUX_COMPONENT_middleware.tfm.profile_small.client_configs)

                config MCUX_COMPONENT_middleware.tfm.qcbor
                    bool "QCBOR"
            endmenu

            config MCUX_COMPONENT_middleware.tfm.s.protected_storage
                bool "Protected Storage" 
                default y if (MCUX_COMPONENT_middleware.tfm.profile_large || MCUX_COMPONENT_middleware.tfm.profile_medium)

            config MCUX_COMPONENT_middleware.tfm.s.partition_load_ps
                bool    
            
            config MCUX_COMPONENT_middleware.tfm.s.partition_ps
                bool    
            
            config MCUX_COMPONENT_middleware.tfm.s.test.partition_load_ps_tests
                bool
            
            config MCUX_COMPONENT_middleware.tfm.s.test.partition_ps_tests
                bool
        
            config MCUX_COMPONENT_middleware.tfm.s.its
                bool "Internal Trusted Storage"
                select MCUX_COMPONENT_middleware.tfm.s.its.load_info_common if (!(MCUX_HW_DEVICE_RW610 || MCUX_HW_DEVICE_RW612))
                select MCUX_COMPONENT_middleware.tfm.s.its.load_info_rw61x if (MCUX_HW_DEVICE_RW610 || MCUX_HW_DEVICE_RW612)

            config MCUX_COMPONENT_middleware.tfm.s.its.load_info_common
                bool
                depends on (!(MCUX_HW_DEVICE_RW610 || MCUX_HW_DEVICE_RW612))

            config MCUX_COMPONENT_middleware.tfm.s.its.load_info_rw61x
                bool
                depends on (MCUX_HW_DEVICE_RW610 || MCUX_HW_DEVICE_RW612)

            config MCUX_COMPONENT_middleware.tfm.s.loader_service
                bool "Loader Service"
                select MCUX_COMPONENT_driver.conn_fwloader
                depends on MCUX_HW_DEVICE_RW610 || MCUX_HW_DEVICE_RW612
        endmenu

        menu "Flash Drivers"    
            config MCUX_COMPONENT_middleware.tfm.flash_mcxw23
                bool "MCXW23"
                select MCUX_COMPONENT_driver.romapi

            config MCUX_COMPONENT_middleware.tfm.flash_mcxl20
                bool "MCXL20"
                select MCUX_COMPONENT_driver.romapi

            config MCUX_COMPONENT_middleware.tfm.flash_iap1
                bool "IAP1"
                select MCUX_COMPONENT_driver.iap1

            config MCUX_COMPONENT_middleware.tfm.flash_iap
                bool "IAP"
                select MCUX_COMPONENT_driver.iap

            config MCUX_COMPONENT_middleware.tfm.flash_iap_n4a
                bool "IAP N4A"
                select MCUX_COMPONENT_driver.flashiap

            config MCUX_COMPONENT_middleware.tfm.flash_mcxn
                bool "MCXn"
                select MCUX_COMPONENT_driver.romapi_flashiap

            config MCUX_COMPONENT_middleware.tfm.romapi_rw61x
                bool "RW61x"
                select MCUX_COMPONENT_driver.romapi
                select MCUX_COMPONENT_driver.iped_rw61x

            config MCUX_COMPONENT_middleware.tfm.flash_k4
                bool "K4"
                select MCUX_COMPONENT_driver.flash_k4

            config MCUX_COMPONENT_middleware.tfm.flash_k4_romapi
                bool "K4 ROMAPI"
                select MCUX_COMPONENT_driver.romapi

            config MCUX_COMPONENT_middleware.tfm.flash_rt700
                bool "RT700"
                select MCUX_COMPONENT_component.mflash_offchip

            config MCUX_COMPONENT_middleware.tfm.flash_dummy
                bool "Dummy flash Driver for platforms with no Flash"
        endmenu

        menu "Serial Comm Drivers"
            config MCUX_COMPONENT_middleware.tfm.lpuart
                bool "LPUART"

            config MCUX_COMPONENT_middleware.tfm.usart
                bool "USART"
                select MCUX_COMPONENT_driver.flexcomm_usart
        endmenu

        menu "Crypto cipher module with Medium profile"
            config MCUX_COMPONENT_middleware.tfm.enable_crypto_cipher_module
                bool "Enable Crypto Cipher Module"
                default y if (MCUX_COMPONENT_middleware.tfm.profile_medium && MCUX_COMPONENT_middleware.tfm.s)

        endmenu

        menu "Option to use RAM FS for platform with no flash option"
            config MCUX_COMPONENT_middleware.tfm.enable_platform_no_flash
                bool "Enable ITS, PSA and OTP/NC Counters on RAM FS"

        endmenu

    endmenu

    # -------- secure processing environment configs end here ----------------
    config MCUX_COMPONENT_middleware.tfm.secure_crypto_clients
        bool "Secure Crypto Clients"
        select MCUX_COMPONENT_middleware.tfm.s.partition_ps if ((MCUX_COMPONENT_middleware.tfm.profile_large || MCUX_COMPONENT_middleware.tfm.profile_medium) || MCUX_COMPONENT_middleware.tfm.s.protected_storage)
        select MCUX_COMPONENT_middleware.tfm.s.initial_attestation
        select MCUX_COMPONENT_middleware.tfm.board_headers
        select MCUX_COMPONENT_middleware.tfm.driver_headers
        select MCUX_COMPONENT_middleware.tfm.common_headers

    config MCUX_COMPONENT_middleware.tfm.secure_reg_test_enable
        bool "Secure Regression Suites"
        select MCUX_COMPONENT_middleware.tfm.s.test.attestation.asymmetric if (MCUX_COMPONENT_middleware.tfm.profile_large || MCUX_COMPONENT_middleware.tfm.profile_medium)
        select MCUX_COMPONENT_middleware.tfm.s.test.attestation.symmetric if (MCUX_COMPONENT_middleware.tfm.profile_small)
        select MCUX_COMPONENT_middleware.tfm.s.test.partition_ps_tests if ((MCUX_COMPONENT_middleware.tfm.profile_large || MCUX_COMPONENT_middleware.tfm.profile_medium) || MCUX_COMPONENT_middleware.tfm.s.test.protected_storage)
        select MCUX_COMPONENT_middleware.tfm.s.test.crypto
        select MCUX_COMPONENT_middleware.tfm.s.test.its
        select MCUX_COMPONENT_middleware.tfm.board_headers
        select MCUX_COMPONENT_middleware.tfm.driver_headers
        select MCUX_COMPONENT_middleware.tfm.common_headers

    # -------- Isolation level configs define here ----------------
    if MCUX_COMPONENT_middleware.tfm.s || MCUX_COMPONENT_middleware.tfm.ns || MCUX_COMPONENT_middleware.tfm.secure_crypto_clients || MCUX_COMPONENT_middleware.tfm.secure_reg_test_enable      
      choice
        prompt "TFM Isolation"
        default MCUX_COMPONENT_middleware.tfm.isolation_level_2 if (MCUX_COMPONENT_middleware.tfm.profile_medium || MCUX_COMPONENT_middleware.tfm.profile_large)
        default MCUX_COMPONENT_middleware.tfm.isolation_level_1 if (MCUX_COMPONENT_middleware.tfm.profile_small)

        config MCUX_COMPONENT_middleware.tfm.isolation_level_1
            bool "Level 1"

        config MCUX_COMPONENT_middleware.tfm.isolation_level_2
            bool "Level 2"

        config MCUX_COMPONENT_middleware.tfm.isolation_level_3
            bool "Level 3"
            # Note: This remains available; users can select it explicitly
      endchoice
    endif


    config MCUX_COMPONENT_middleware.tfm.s.isolation_1
        bool
        default y if (MCUX_COMPONENT_middleware.tfm.isolation_level_1 && MCUX_COMPONENT_middleware.tfm.s)

    config MCUX_COMPONENT_middleware.tfm.s.isolation_1_cfg
        bool
        default y if (MCUX_COMPONENT_middleware.tfm.isolation_level_1 )

    config MCUX_COMPONENT_middleware.tfm.s.isolation_2
        bool
        default y if (MCUX_COMPONENT_middleware.tfm.isolation_level_2 && MCUX_COMPONENT_middleware.tfm.s)
        
    config MCUX_COMPONENT_middleware.tfm.s.isolation_2_cfg
        bool
        default y if (MCUX_COMPONENT_middleware.tfm.isolation_level_2)

    # -------- TF-M profile configs define here ----------------
    if MCUX_COMPONENT_middleware.tfm.s || MCUX_COMPONENT_middleware.tfm.ns || MCUX_COMPONENT_middleware.tfm.secure_crypto_clients || MCUX_COMPONENT_middleware.tfm.secure_reg_test_enable
      choice
        prompt "TFM Profile"
        default MCUX_COMPONENT_middleware.tfm.profile_medium

        config MCUX_COMPONENT_middleware.tfm.profile_large
            bool "Large"

        config MCUX_COMPONENT_middleware.tfm.profile_medium
            bool "Medium"

        config MCUX_COMPONENT_middleware.tfm.profile_small
            bool "Small"
      endchoice
    endif

    #tfm profile additional configs to support mcu-sdk kex package, No example shall select these manually
    #----------------------------------------------section for large profile configs----------------------------------
    config MCUX_COMPONENT_middleware.tfm.profile_large.s_configs
        bool
        default y if (MCUX_COMPONENT_middleware.tfm.profile_large && MCUX_COMPONENT_middleware.tfm.s)

    config MCUX_COMPONENT_middleware.tfm.profile_large.s_test_configs
        bool
        default y if (MCUX_COMPONENT_middleware.tfm.profile_large && (MCUX_COMPONENT_middleware.tfm.s.test || MCUX_COMPONENT_middleware.tfm.secure_reg_test_enable))

    config MCUX_COMPONENT_middleware.tfm.profile_large.client_configs
        bool
        default y if (MCUX_COMPONENT_middleware.tfm.profile_large && (MCUX_COMPONENT_middleware.tfm.ns || MCUX_COMPONENT_middleware.tfm.secure_crypto_clients ||    MCUX_COMPONENT_middleware.tfm.secure_reg_test_enable))

    config MCUX_COMPONENT_middleware.tfm.profile_large.ns_test_configs
        bool
        default y if (MCUX_COMPONENT_middleware.tfm.profile_large && MCUX_COMPONENT_middleware.tfm.ns.test)

        #----------------------------------------------section for medium profile configs---------------------------------

    config MCUX_COMPONENT_middleware.tfm.profile_medium.s_configs
        bool
        default y if (MCUX_COMPONENT_middleware.tfm.profile_medium && MCUX_COMPONENT_middleware.tfm.s)

    config MCUX_COMPONENT_middleware.tfm.profile_medium.s_test_configs
        bool
        default y if (MCUX_COMPONENT_middleware.tfm.profile_medium && (MCUX_COMPONENT_middleware.tfm.s.test || MCUX_COMPONENT_middleware.tfm.secure_reg_test_enable))

    config MCUX_COMPONENT_middleware.tfm.profile_medium.client_configs
        bool
        default y if (MCUX_COMPONENT_middleware.tfm.profile_medium && (MCUX_COMPONENT_middleware.tfm.ns || MCUX_COMPONENT_middleware.tfm.secure_crypto_clients ||     MCUX_COMPONENT_middleware.tfm.secure_reg_test_enable))

    config MCUX_COMPONENT_middleware.tfm.profile_medium.ns_test_configs
        bool
        default y if (MCUX_COMPONENT_middleware.tfm.profile_medium && MCUX_COMPONENT_middleware.tfm.ns.test)

        #----------------------------------------------section for small profile configs----------------------------------

    config MCUX_COMPONENT_middleware.tfm.profile_small.s_configs
        bool
        default y if (MCUX_COMPONENT_middleware.tfm.profile_small && MCUX_COMPONENT_middleware.tfm.s)

    config MCUX_COMPONENT_middleware.tfm.profile_small.s_test_configs
        bool
        default y if (MCUX_COMPONENT_middleware.tfm.profile_small && (MCUX_COMPONENT_middleware.tfm.s.test || MCUX_COMPONENT_middleware.tfm.secure_reg_test_enable))

    config MCUX_COMPONENT_middleware.tfm.profile_small.client_configs
        bool
        default y if (MCUX_COMPONENT_middleware.tfm.profile_small && (MCUX_COMPONENT_middleware.tfm.ns || MCUX_COMPONENT_middleware.tfm.secure_crypto_clients ||    MCUX_COMPONENT_middleware.tfm.secure_reg_test_enable))

    config MCUX_COMPONENT_middleware.tfm.profile_small.ns_test_configs
        bool
        default y if (MCUX_COMPONENT_middleware.tfm.profile_small && MCUX_COMPONENT_middleware.tfm.ns.test)



    #------------------------------------------------End of profile related configs-----------------------------------
    #----------------------------------------------section for profile configs of psa-arch-test --------------------------
    menu "psa-arch-test-profile"
    config MCUX_COMPONENT_middleware.tfm.profile_large.ns_psatest_configs
        bool "large"
        default y if (MCUX_COMPONENT_middleware.tfm.profile_large && MCUX_COMPONENT_middleware.psatest.ns.crypto)

    config MCUX_COMPONENT_middleware.tfm.profile_medium.ns_psatest_configs
        bool "medium"
        default y if (MCUX_COMPONENT_middleware.tfm.profile_medium && MCUX_COMPONENT_middleware.psatest.ns.crypto)

    config MCUX_COMPONENT_middleware.tfm.profile_small.ns_psatest_configs
        bool "small"
        default y if (MCUX_COMPONENT_middleware.tfm.profile_small && MCUX_COMPONENT_middleware.psatest.ns.crypto)
    endmenu

    #------------------------------------------------End of psa-profile related configs-----------------------------------        
    menu "Non-Secure Processing Environment"
    config MCUX_COMPONENT_middleware.tfm.ns
        bool "TF-M Non Secure"
        select MCUX_COMPONENT_middleware.tfm.ns.board
        if MCUX_COMPONENT_middleware.tfm.ns
            choice
                prompt "OS Wrapper"
                default MCUX_COMPONENT_middleware.tfm.ns.os_wrapper.rtos if (MCUX_COMPONENT_CMSIS_RTOS2_RTX || MCUX_COMPONENT_middleware.freertos-kernel.tfm_ns)

                config MCUX_COMPONENT_middleware.tfm.ns.os_wrapper.baremetal
                    bool "Baremetal"

                config MCUX_COMPONENT_middleware.tfm.ns.os_wrapper.rtos
                    bool "RTOS"
            endchoice
        endif

    config MCUX_COMPONENT_middleware.tfm.ns.board
        bool
        select MCUX_COMPONENT_middleware.tfm.board_headers
        select MCUX_COMPONENT_middleware.tfm.driver_headers
        select MCUX_COMPONENT_middleware.tfm.common_headers

    config MCUX_COMPONENT_middleware.tfm.ns.loader_service
        bool "NS Loader Service Interface"
        select MCUX_COMPONENT_driver.conn_fwloader_ns
        depends on MCUX_HW_DEVICE_RW610 || MCUX_HW_DEVICE_RW612
        default y if MCUX_COMPONENT_middleware.tfm.ns

    config MCUX_COMPONENT_middleware.tfm.ns.platform_rw61x
        bool "NS Platform RW61x interface"
        depends on MCUX_HW_DEVICE_RW610 || MCUX_HW_DEVICE_RW612
        default y if MCUX_COMPONENT_middleware.tfm.ns
    endmenu

    menu "TF-M Regression Tests"
        menu "TF-M Secure Tests"
            config MCUX_COMPONENT_middleware.tfm.s.test
                bool "Secure Test Framework"

            config MCUX_COMPONENT_middleware.tfm.s.test.protected_storage
                bool "S Protected Storage"
                default y if (MCUX_COMPONENT_middleware.tfm.s.test && (MCUX_COMPONENT_middleware.tfm.profile_large || MCUX_COMPONENT_middleware.tfm.profile_medium))

            config MCUX_COMPONENT_middleware.tfm.s.test.its
                bool "S Internal Trusted Storage"

            menu "Initial Attestation"
                config MCUX_COMPONENT_middleware.tfm.s.test.attestation.asymmetric
                    bool "S Attestation Asymmetric"
                    select MCUX_COMPONENT_middleware.tfm.qcbor
                    select MCUX_COMPONENT_middleware.tfm.s.test.attestation
                    select MCUX_COMPONENT_middleware.tfm.t_cose.sign1_verify

                config MCUX_COMPONENT_middleware.tfm.s.test.attestation.symmetric
                    bool "S Attestation Symmetric"
                    select MCUX_COMPONENT_middleware.tfm.qcbor
                    select MCUX_COMPONENT_middleware.tfm.s.test.attestation
                    select MCUX_COMPONENT_middleware.tfm.t_cose.mac0_verify

                config MCUX_COMPONENT_middleware.tfm.s.test.attestation
                    bool
                config MCUX_COMPONENT_middleware.tfm.t_cose.sign1_verify
                    bool
                config MCUX_COMPONENT_middleware.tfm.t_cose.mac0_verify
                    bool
                config MCUX_COMPONENT_middleware.tfm.qcbor.test
                    bool "S QCBOR Test"
            endmenu
            config MCUX_COMPONENT_middleware.tfm.s.test.crypto
                bool "S Crypto"
            config MCUX_COMPONENT_middleware.tfm.s.test.platform
                bool "S Platform"
            config MCUX_COMPONENT_middleware.tfm.s.test.ipc
                bool "S IPC Test"
            config MCUX_COMPONENT_middleware.tfm.s.test.irq_slih
                bool "S IRQ SLIH Test"
                select MCUX_COMPONENT_middleware.tfm.platform_test
            config MCUX_COMPONENT_middleware.tfm.s.test.irq_flih
                bool "S IRQ FLIH Test"
                select MCUX_COMPONENT_middleware.tfm.platform_test
            config MCUX_COMPONENT_middleware.tfm.platform_test
                bool
        endmenu

        menu "TF-M Non-Secure Tests"
            config MCUX_COMPONENT_middleware.tfmtests.ns
                bool "Non-Secure Tests Framework"
                select MCUX_COMPONENT_CMSIS_RTOS2_RTX

            config MCUX_COMPONENT_middleware.tfm.ns.test
                bool "NS Regression Tests Enable"
                select MCUX_COMPONENT_middleware.tfm.ns.test.its
                select MCUX_COMPONENT_middleware.tfm.ns.test.attestation.asymmetric if (MCUX_COMPONENT_middleware.tfm.profile_large || MCUX_COMPONENT_middleware.tfm.profile_medium)
                select MCUX_COMPONENT_middleware.tfm.ns.test.attestation.symmetric if (MCUX_COMPONENT_middleware.tfm.profile_small)
                select MCUX_COMPONENT_middleware.tfm.ns.test.crypto

            config MCUX_COMPONENT_middleware.tfm.ns.test.default_app
                bool "NS Default Test App"

            config MCUX_COMPONENT_middleware.tfm.ns.test.psatest_app
                bool "NS PSA Test App"

            config MCUX_COMPONENT_middleware.tfm.ns.test.ps
                bool "NS Protected Storage"
                default y if (MCUX_COMPONENT_middleware.tfm.ns.test && (MCUX_COMPONENT_middleware.tfm.profile_large || MCUX_COMPONENT_middleware.tfm.profile_medium))
            
            config MCUX_COMPONENT_middleware.tfm.ns.test.its
                bool "NS Internal Trusted Storage"

            config MCUX_COMPONENT_middleware.tfm.ns.test.s
                bool "NS Secure Client Test"

            menu "Initial Attestation"
                config MCUX_COMPONENT_middleware.tfm.ns.test.attestation.asymmetric
                    bool "NS Attestation Asymmetric"
                    select MCUX_COMPONENT_middleware.tfm.ns.test.attestation
                    select MCUX_COMPONENT_middleware.tfmtests.ns.test.attestation.asymmetric
                    select MCUX_COMPONENT_middleware.tfm.t_cose.sign1_verify
                config MCUX_COMPONENT_middleware.tfm.ns.test.attestation.symmetric
                    bool "NS Attestation Symmetric"
                    select MCUX_COMPONENT_middleware.tfm.ns.test.attestation
                    select MCUX_COMPONENT_middleware.tfmtests.ns.test.attestation.symmetric
                    select MCUX_COMPONENT_middleware.tfm.t_cose.mac0_verify
                config MCUX_COMPONENT_middleware.tfm.ns.test.attestation
                    bool
                    select MCUX_COMPONENT_middleware.tfm.qcbor
                    select MCUX_COMPONENT_middleware.tfm.qcbor.test
                    select MCUX_COMPONENT_middleware.tfmtests.ns.test.attestation
                config MCUX_COMPONENT_middleware.tfmtests.ns.test.attestation.asymmetric
                    bool
                    select MCUX_COMPONENT_middleware.tfmtests.ns.test.attestation
                config MCUX_COMPONENT_middleware.tfmtests.ns.test.attestation.symmetric
                    bool
                    select MCUX_COMPONENT_middleware.tfmtests.ns.test.attestation
                config MCUX_COMPONENT_middleware.tfmtests.ns.test.attestation
                    bool
                config MCUX_COMPONENT_middleware.tfm.ns.test.qcbor
                    bool "NS QCBOR Test"
            endmenu

            config MCUX_COMPONENT_middleware.tfm.ns.test.crypto
                bool "NS Crypto Test"

            config MCUX_COMPONENT_middleware.tfm.ns.test.ipc
                bool "NS IPC Test"
                default y if (MCUX_COMPONENT_middleware.tfm.ns.test && (MCUX_COMPONENT_middleware.tfm.isolation_level_2 || MCUX_COMPONENT_middleware.tfm.isolation_level_3))

            config MCUX_COMPONENT_middleware.tfm.ns.test.irq_slih
                bool "NS IRQ SLIH Test"
                select MCUX_COMPONENT_middleware.tfm.platform_test

            config MCUX_COMPONENT_middleware.tfm.ns.test.irq_flih
                bool "NS IRQ FLIH Test"
                select MCUX_COMPONENT_middleware.tfm.platform_test

            config MCUX_COMPONENT_middleware.tfm.ns.test.platform
                bool "NS test platform"

            config MCUX_COMPONENT_middleware.tfm.ns.test.tcose
                bool "NS Test T_COSE"
                select MCUX_COMPONENT_middleware.tfmtests.ns.test.tcose

            config MCUX_COMPONENT_middleware.tfmtests.ns.test.tcose
                bool
        endmenu
    endmenu

    #----------------------------
    #  psa-arch-test configs
    #----------------------------
    menu "TF-M PSA-Arch Tests"
        config MCUX_COMPONENT_middleware.psatest.ns
            bool "PSA Test Framework"
            select MCUX_COMPONENT_middleware.psatest.ns.tgt_dev_apis_nxp
            select MCUX_COMPONENT_middleware.tfm.ns.test.psatest_app if (MCUX_COMPONENT_middleware.tfmtests.ns)

        config MCUX_COMPONENT_middleware.psatest.ns.tgt_dev_apis_nxp
            bool

            if MCUX_COMPONENT_middleware.psatest.ns.tgt_dev_apis_nxp
                choice
                    default MCUX_DEPENDENCY_COMPONENT_middleware.psatest.ns.tgt_dev_apis_nxp_default
                    prompt "Choice tgt_dev_apis_nxp_rw61x_configs"
                    config MCUX_DEPENDENCY_COMPONENT_middleware.psatest.ns.tgt_dev_apis_nxp_rw61x_configs
                        bool "RW61x dev apis nxp configs"
                        select MCUX_COMPONENT_middleware.psatest.ns.tgt_dev_apis_nxp_rw61x_configs
                        depends on (MCUX_HW_DEVICE_RW610 || MCUX_HW_DEVICE_RW612)
                    config MCUX_DEPENDENCY_COMPONENT_middleware.psatest.ns.tgt_dev_apis_nxp_default
                        bool "Default dev apis nxp configs"
                        depends on !(MCUX_HW_DEVICE_RW610 || MCUX_HW_DEVICE_RW612)
                endchoice
            endif

        config MCUX_COMPONENT_middleware.psatest.ns.tgt_dev_apis_nxp_rw61x_configs
            bool "PSA Test Dev APIs RW61x Configs"
            depends on (MCUX_HW_DEVICE_RW610 || MCUX_HW_DEVICE_RW612)
    
        menu "Tests Suites"
            config MCUX_COMPONENT_middleware.psatest.ns.crypto
                bool "Crypto"

            config MCUX_COMPONENT_middleware.psatest.ns.disable_crypto_cipher_module
                bool "Disable crypto cipher module tests"

            config MCUX_COMPONENT_middleware.psatest.ns.initial_attestation
                bool "Initial Attestation"
                select MCUX_COMPONENT_middleware.tfm.qcbor
                select MCUX_COMPONENT_middleware.psatest.ns.t_cose

            config MCUX_COMPONENT_middleware.psatest.ns.t_cose
                bool

            config MCUX_COMPONENT_middleware.psatest.ns.protected_storage
                bool "Protected Storage"

            config MCUX_COMPONENT_middleware.psatest.ns.internal_trusted_storage
                bool "Internal Trusted Storage"

            config MCUX_COMPONENT_middleware.psatest.ns.crypto_s200_config
                bool
                depends on ((MCUX_HW_DEVICE_KW45Z41052 || MCUX_HW_DEVICE_KW45Z41053 || MCUX_HW_DEVICE_KW45Z41082 || MCUX_HW_DEVICE_KW45Z41083 || MCUX_HW_DEVICE_KW45B41Z82 || MCUX_HW_DEVICE_KW45B41Z52 || MCUX_HW_DEVICE_KW45B41Z53 || MCUX_HW_DEVICE_KW45B41Z83 || MCUX_HW_DEVICE_K32W1480 || MCUX_HW_DEVICE_MCXW716C || MCUX_HW_DEVICE_MCXW716A || MCUX_HW_DEVICE_MCXW727A || MCUX_HW_DEVICE_MCXW727C || MCUX_HW_DEVICE_MCXW727D || MCUX_HW_DEVICE_KW47B42Z83 || MCUX_HW_DEVICE_KW47B42Z96 || MCUX_HW_DEVICE_KW47B42Z97 || MCUX_HW_DEVICE_KW47B42ZB2 || MCUX_HW_DEVICE_KW47B42ZB3 || MCUX_HW_DEVICE_KW47B42ZB6 || MCUX_HW_DEVICE_KW47B42ZB7 || MCUX_HW_DEVICE_KW47Z42082 || MCUX_HW_DEVICE_KW47Z42092 || MCUX_HW_DEVICE_KW47Z420B2 || MCUX_HW_DEVICE_KW47Z420B3))
                default y if MCUX_COMPONENT_middleware.psatest.ns.crypto
        endmenu
    endmenu
endmenu
```
